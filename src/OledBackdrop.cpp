#include "OledBackdrop.h"
#include "ConfigManager.h" // Lấy thông số cấu hình để hiển thị
// WiFiManager header removed as it is no longer used directly
#include "main.h"		   // Import version
#include <WiFi.h>          // Để lây thông tin địa chỉ IP
#include "WiFiSelfEnroll.h"// Lấy cấu hình AP mặc định

// Logo bụi mịn (Chuyển đổi từ ảnh 50x50 của bạn)
static const unsigned char logo_dust_50x50[] = {
	0xff, 0xff, 0xff, 0xff, 0xff, 0xff, 0xc0, 0xff, 0xff, 0xff, 0xff, 0xff, 0xff, 0xc0, 0xff, 0xff,
	0xff, 0xff, 0xff, 0xff, 0xc0, 0xff, 0xff, 0xff, 0xdf, 0xff, 0xff, 0xc0, 0xff, 0xff, 0xff, 0xff,
	0xff, 0xff, 0xc0, 0xff, 0xff, 0xff, 0xff, 0xff, 0xff, 0xc0, 0xff, 0xff, 0xff, 0xff, 0xff, 0xff,
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	0xff, 0xff, 0xff, 0xff, 0xff, 0xff, 0xc0, 0xff, 0xff, 0xff, 0xff, 0xff, 0xff, 0xc0};

void showWelcomeScreen(U8G2_SH1106_128X64_NONAME_F_HW_I2C &u8g2)
{
	u8g2.clearBuffer();

	// 1. VÙNG TRẠNG THÁI (TOP)
	u8g2.setFont(u8g2_font_5x7_tr);
	u8g2.drawStr(2, 10, "WiFi:");
	u8g2.drawStr(32, 10, (configMgr.params.wifiEnabled) ? configMgr.params.ssid.c_str() : "OFF");

	// 2. LOGO BÊN TRÁI (50x50)
	u8g2.drawXBM(2, 16, 50, 50, logo_dust_50x50);

	// 3. PHẦN CHỮ BÊN PHẢI
	u8g2.setFont(u8g2_font_unifont_t_vietnamese2);
	// Vì "Kiểm soát thí sinh" quá dài và không có font tiếng Việt U8G2 nào nhỏ hơn 16px, ta nên chia làm 2 dòng
	u8g2.drawUTF8(55, 26, "Kiểm soát");
	u8g2.drawUTF8(55, 41, "thí sinh");

	u8g2.setFont(u8g2_font_5x7_tr);
	u8g2.drawStr(55, 53, "RFID, QR");

	// Sử dụng hằng số từ main.h
	u8g2.setFont(u8g2_font_5x7_tr);
	u8g2.setCursor(55, 62);
	u8g2.print("Ver: ");
	u8g2.print(FIRMWARE_VERSION); // Gọi từ main.h

	u8g2.sendBuffer();
}

/**
 * Hàm hỗ trợ vẽ văn bản có tự động xuống dòng nếu quá dài
 */
void drawSmartText(U8G2_SH1106_128X64_NONAME_F_HW_I2C &u8g2, int x, int &y, const char *label, String value)
{
	u8g2.setCursor(x, y);
	u8g2.print(label);

	int labelWidth = u8g2.getStrWidth(label);
	int valueWidth = u8g2.getStrWidth(value.c_str());
	int maxWidth = 120 - labelWidth; // Khoảng trống còn lại trên dòng

	if (valueWidth <= maxWidth)
	{
		u8g2.print(value);
		y += 12; // Xuống dòng cho mục tiếp theo
	}
	else
	{
		// Nếu quá dài, cắt chuỗi hoặc xuống dòng đơn giản
		// Cách đơn giản nhất: In nhãn, xuống dòng rồi in giá trị đầy đủ
		y += 10;
		u8g2.setCursor(x + 10, y); // Thụt lề một chút cho đẹp
		u8g2.print(value);
		y += 12;
	}
}

void showFlashConfig(U8G2_SH1106_128X64_NONAME_F_HW_I2C &u8g2, const char *moretext)
{
	u8g2.clearBuffer();

	// Tiêu đề
	u8g2.setFont(u8g2_font_6x12_tr);
	u8g2.setCursor(0, 10);
	u8g2.print("DeviceId: ");
	u8g2.print(configMgr.params.deviceID);

	int y = 25;
	// Hiển thị SSID
	drawSmartText(u8g2, 0, y, "SSID: ", configMgr.params.ssid);

	// Hiển thị Device ID (Masked Password)
	String maskedPass = "****";
	if (configMgr.params.password.length() > 2) {
		maskedPass += configMgr.params.password.substring(configMgr.params.password.length() - 2);
	} else if (configMgr.params.password.length() > 0) {
		maskedPass += configMgr.params.password;
	} else {
		maskedPass = ""; // Empty password
	}
	drawSmartText(u8g2, 0, y, "Pass: ", maskedPass);

	// --- HIỂN THỊ TRẠNG THÁI WIFI ---
	u8g2.setCursor(0, y);
	u8g2.print("WiFi: ");
	if (!configMgr.params.wifiEnabled)
	{
		u8g2.print("OFF");
	}
	else
	{
		if (wifiStatus)
		{
			u8g2.print(WiFi.localIP().toString());
		}
		else
		{
			u8g2.print("fail [X]");
		}
	}

	// Thêm thông tin hiển thị
	if (moretext != NULL)
	{
		y+=12;
		u8g2.setCursor(0, y);		
		u8g2.println(moretext);
	}

	u8g2.sendBuffer();
}

void showAPConfig(U8G2_SH1106_128X64_NONAME_F_HW_I2C &u8g2)
{
	u8g2.clearBuffer();

	// Tiêu đề
	u8g2.setFont(u8g2_font_6x12_tr);
	u8g2.setCursor(0, 10);
	u8g2.print("--- Access Point ---");

	// Hiển thị SSID AP
	u8g2.setCursor(0, 25);
	u8g2.print("AP:");
	u8g2.print(AP_WIFI_SSID);

	// Mask AP password
	String apPass = "****";
	String rawPass = String(AP_WIFI_PASSWORD);
	if (rawPass.length() > 2) {
		apPass += rawPass.substring(rawPass.length() - 2);
	} else if (rawPass.length() > 0) {
		apPass += rawPass;
	} else {
		apPass = "";
	}

	// Hiển thị Pass
	u8g2.setCursor(0, 40);
	u8g2.print("P:");
	u8g2.print(apPass);
	// Hiển thị IP
	u8g2.setCursor(0, 55);
	u8g2.print("IP: 192.168.15.1");

	u8g2.sendBuffer();
}

void showMqttConfig(U8G2_SH1106_128X64_NONAME_F_HW_I2C &u8g2)
{
	u8g2.clearBuffer();

	// Tiêu đề
	u8g2.setFont(u8g2_font_6x12_tr);
	u8g2.setCursor(0, 10);
	u8g2.print("--- MQTT Service ---");

	int y = 25;
	// Tạo chuỗi Upstream / Downstream
	String tUp = String("monitor_student/") + configMgr.params.deviceID + "/data";
	String tDown = String("monitor_student/") + configMgr.params.deviceID + "/cmd";

	// Hiển thị Topic Up
	drawSmartText(u8g2, 0, y, "Up: ", tUp);

	// Hiển thị Topic Down
	drawSmartText(u8g2, 0, y, "Dn: ", tDown);

	u8g2.sendBuffer();
}