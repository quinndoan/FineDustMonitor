#include "greetingcard.h"
#include "main.h" // Import file cấu hình

// Logo bụi mịn (Chuyển đổi từ ảnh 50x50 của bạn)
static const unsigned char logo_dust_50x50[] = {
	0xff, 0xff, 0xff, 0xff, 0xff, 0xff, 0xc0, 0xff, 0xff, 0xff, 0xff, 0xff, 0xff, 0xc0, 0xff, 0xff,
	0xff, 0xff, 0xff, 0xff, 0xc0, 0xff, 0xff, 0xff, 0xdf, 0xff, 0xff, 0xc0, 0xff, 0xff, 0xff, 0xff,
	0xff, 0xff, 0xc0, 0xff, 0xff, 0xff, 0xff, 0xff, 0xff, 0xc0, 0xff, 0xff, 0xff, 0xff, 0xff, 0xff,
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	0xff, 0xff, 0xff, 0xff, 0xff, 0xff, 0xc0, 0xff, 0xff, 0xff, 0xff, 0xff, 0xff, 0xc0};

void showWelcomeScreen(U8G2_SH1106_128X64_NONAME_F_HW_I2C &u8g2, const char *wifiSSID, const char *btName)
{
	u8g2.clearBuffer();

	// 1. VÙNG TRẠNG THÁI (TOP)
	u8g2.setFont(u8g2_font_5x7_tr);
	u8g2.drawStr(2, 10, "WiFi:");
	u8g2.drawStr(28, 10, (strlen(wifiSSID) > 0) ? wifiSSID : "OFF");

	u8g2.drawStr(70, 10, "BL:");
	u8g2.drawStr(88, 10, (strlen(btName) > 0) ? btName : "OFF");
	u8g2.drawHLine(0, 14, 128);

	// 2. LOGO BÊN TRÁI (50x50)
	u8g2.drawXBM(2, 16, 50, 50, logo_dust_50x50);

	// 3. PHẦN CHỮ BÊN PHẢI
	u8g2.setFont(u8g2_font_unifont_t_vietnamese2);
	u8g2.drawUTF8(55, 30, "Đo Bụi");

	u8g2.setFont(u8g2_font_7x13_mf);
	u8g2.drawStr(55, 45, "PM2.5 PM10");

	// Sử dụng hằng số từ main.h
	u8g2.setFont(u8g2_font_5x7_tr);
	u8g2.setCursor(55, 60);
	u8g2.print("Ver: ");
	u8g2.print(FIRMWARE_VERSION); // Gọi từ main.h

	u8g2.sendBuffer();
}

/**
 * Hàm hỗ trợ vẽ văn bản có tự động xuống dòng nếu quá dài
 */
void drawSmartText(U8G2_SH1106_128X64_NONAME_F_HW_I2C &u8g2, int x, int &y, const char *label, String value)
{
	u8g2.setCursor(x, y);
	u8g2.print(label);

	int labelWidth = u8g2.getStrWidth(label);
	int valueWidth = u8g2.getStrWidth(value.c_str());
	int maxWidth = 120 - labelWidth; // Khoảng trống còn lại trên dòng

	if (valueWidth <= maxWidth)
	{
		u8g2.print(value);
		y += 12; // Xuống dòng cho mục tiếp theo
	}
	else
	{
		// Nếu quá dài, cắt chuỗi hoặc xuống dòng đơn giản
		// Cách đơn giản nhất: In nhãn, xuống dòng rồi in giá trị đầy đủ
		y += 10;
		u8g2.setCursor(x + 10, y); // Thụt lề một chút cho đẹp
		u8g2.print(value);
		y += 12;
	}
}

void showFlashConfig(U8G2_SH1106_128X64_NONAME_F_HW_I2C &u8g2)
{
	u8g2.clearBuffer();

	// Tiêu đề
	u8g2.setFont(u8g2_font_6x12_tr);
	u8g2.setCursor(0, 10);
	u8g2.print("--- FLASH SETTINGS ---");

	int y = 25;
	// Hiển thị SSID
	drawSmartText(u8g2, 0, y, "ID: ", deviceID);
	// Hiển thị SSID
	drawSmartText(u8g2, 0, y, "SSID: ", wifiSSID);

	// Hiển thị Device ID
	drawSmartText(u8g2, 0, y, "Pass: ", wifiPass);

	// --- HIỂN THỊ TRẠNG THÁI WIFI ---
	u8g2.setCursor(0, y);
	u8g2.print("WiFi: ");
	if (!wifiEnabled)
	{
		u8g2.print("OFF");
	}
	else
	{
		if (wifiStatus)
		{
			u8g2.print("okay [V]");
		}
		else
		{
			u8g2.print("fail [X]");
		}
	}

	u8g2.sendBuffer();
}



void showAPConfig(U8G2_SH1106_128X64_NONAME_F_HW_I2C &u8g2, char * apname, char * password )
{
	u8g2.clearBuffer();

	// Tiêu đề
	u8g2.setFont(u8g2_font_6x12_tr);
	u8g2.setCursor(0, 10);
	u8g2.print("--- Access Point ---");

	int y = 25;
	// Hiển thị SSID
	drawSmartText(u8g2, 0, y, "AP: ", apname);
	// Hiển thị SSID
	drawSmartText(u8g2, 0, y, "Password: ", password);

	// Hiển thị Device ID
	u8g2.drawStr(0, y, "IP: 192.168.15.1");

	u8g2.sendBuffer();
}